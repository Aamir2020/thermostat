## main/Kconfig.projbuild
```kconfig
menu "Example Configuration"

    orsource "$IDF_PATH/examples/common_components/env_caps/$IDF_TARGET/Kconfig.env_caps"

    choice EXAMPLE_CHIP_TYPE
        prompt "Select chip type"
        default EXAMPLE_TYPE_DHT11

        config EXAMPLE_TYPE_DHT11
            bool "DHT11"
        config EXAMPLE_TYPE_AM2301
            bool "DHT21/DHT22/AM2301/AM2302/AM2321"
        config EXAMPLE_TYPE_SI7021
            bool "Itead Si7021"
    endchoice

    config EXAMPLE_DATA_GPIO
        int "Data GPIO number"
        default 4 if IDF_TARGET_ESP8266
        default 4 if IDF_TARGET_ESP32C2 || IDF_TARGET_ESP32C3 || IDF_TARGET_ESP32C5 || IDF_TARGET_ESP32C6 || IDF_TARGET_ESP32C61
        default 4 if IDF_TARGET_ESP32H2
        default 4 if IDF_TARGET_ESP32P4
        default 4 if IDF_TARGET_ESP32 || IDF_TARGET_ESP32S2 || IDF_TARGET_ESP32S3
        help
            GPIO number connected to DATA pin

    config EXAMPLE_INTERNAL_PULLUP
        bool "Enable internal pull-up resistor"
        default 0
        help
        	Check this option if you don't have external pull-up resistor on data GPIO.
        	DHT sensors that come mounted on a PCB generally have pull-up resistors on the data pin.
        	But for stable operation, it is recommended to provide an external pull-up resistor.

    choice BLINK_LED
        prompt "Blink LED type"
        default BLINK_LED_GPIO
        help
            Select the LED type. A normal level controlled LED or an addressable LED strip.
            The default selection is based on the Espressif DevKit boards.
            You can change the default selection according to your board.

        config BLINK_LED_GPIO
            bool "GPIO"
        config BLINK_LED_STRIP
            bool "LED strip"
    endchoice

    choice BLINK_LED_STRIP_BACKEND
        depends on BLINK_LED_STRIP
        prompt "LED strip backend peripheral"
        default BLINK_LED_STRIP_BACKEND_RMT if SOC_RMT_SUPPORTED
        default BLINK_LED_STRIP_BACKEND_SPI
        help
            Select the backend peripheral to drive the LED strip.

        config BLINK_LED_STRIP_BACKEND_RMT
            depends on SOC_RMT_SUPPORTED
            bool "RMT"
        config BLINK_LED_STRIP_BACKEND_SPI
            bool "SPI"
    endchoice

    config BLINK_GPIO
        int "Blink GPIO number"
        range ENV_GPIO_RANGE_MIN ENV_GPIO_OUT_RANGE_MAX
        default 8
        help
            GPIO number (IOxx) to blink on and off the LED.
            Some GPIOs are used for other purposes (flash connections, etc.) and cannot be used to blink.

    config BLINK_PERIOD
        int "Blink period in ms"
        range 10 3600000
        default 1000
        help
            Define the blinking period in milliseconds.

endmenu
```
